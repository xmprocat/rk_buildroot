## configs/rockchip_rk3506_defconfig
```kconfig
#include "base/base.config"
#include "chips/rk3506_arm.config"
#include "fs/vfat.config"
#include "multimedia/audio.config"
#include "gui/lvgl/lvgl_rkadk.config"
#include "gui/lvgl/rk_demo.config"
#include "fs/ubifs.config"
# BR2_BACKUP_SITE is reset to default
BR2_INIT_SYSTEMD=y
# BR2_PACKAGE_ANDROID_ADBD is reset to default
BR2_PACKAGE_BZIP2=y
BR2_PACKAGE_ETHTOOL=y
BR2_PACKAGE_EVTEST=y
BR2_PACKAGE_HOST_KMOD=y
# BR2_PACKAGE_HOST_PYTHON3 is reset to default
BR2_PACKAGE_IPSET=y
BR2_PACKAGE_IPTABLES=y
BR2_PACKAGE_IPTABLES_BPF_NFSYNPROXY=y
BR2_PACKAGE_IPTABLES_NFTABLES=y
BR2_PACKAGE_KMOD_LCD=y
BR2_PACKAGE_LIBCURL=y
BR2_PACKAGE_LIBEVDEV=y
BR2_PACKAGE_LIBNL=y
BR2_PACKAGE_LRZSZ=y
# BR2_PACKAGE_LVGL_DEMO is reset to default
BR2_PACKAGE_MHZ=y
BR2_PACKAGE_OPENSSL=y
# BR2_PACKAGE_PULSEAUDIO is reset to default
BR2_PACKAGE_QT5=y
BR2_PACKAGE_RIPGREP=y
BR2_PACKAGE_RKSCRIPT_MOUNTALL=y
BR2_PACKAGE_ROCKCHIP_RGA=y
# BR2_PACKAGE_SYSTEMD_HOSTNAMED is not set
# BR2_PACKAGE_SYSTEMD_HWDB is not set
BR2_PRIMARY_SITE="https://mirror.nju.edu.cn/buildroot"
BR2_ROCKCHIP_ALSA_CONFIG_INSTALL_INIT_SCRIPT=y
BR2_ROOTFS_OVERLAY+="board/rockchip/rk3506/fast-display-overlay/"
BR2_ROOTFS_POST_BUILD_SCRIPT+="board/rockchip/rk3506/post-build-fast-display.sh"
BR2_SYSTEM_BIN_SH_BUSYBOX=y
# BR2_TARGET_GENERIC_REMOUNT_ROOTFS_RW is not set
BR2_TARGET_GENERIC_ROOT_PASSWD="miao"
BR2_TARGET_ROOTFS_SQUASHFS4_ZSTD=y
BR2_TIME_BITS_64=y
```

## package/kmod_lcd/Config.in
```kconfig
config BR2_PACKAGE_KMOD_LCD
	bool "kmod_lcd"
	help
	  ST7789V LCD kernel module for YJH MiniPDA
```
